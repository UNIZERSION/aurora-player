## pico-bridge/native-idf/sdkconfig.defaults
```kconfig
CONFIG_IDF_TARGET="esp32"
CONFIG_ESPTOOLPY_FLASHSIZE_4MB=y
CONFIG_ESPTOOLPY_FLASHMODE_DIO=y
CONFIG_ESPTOOLPY_FLASHFREQ_40M=y
CONFIG_ESP_DEFAULT_CPU_FREQ_MHZ_240=y
CONFIG_PARTITION_TABLE_CUSTOM=y
CONFIG_PARTITION_TABLE_CUSTOM_FILENAME="partitions.csv"
CONFIG_BT_ENABLED=y
CONFIG_BT_BLUEDROID_ENABLED=y
CONFIG_BT_CLASSIC_ENABLED=y
CONFIG_BTDM_CTRL_MODE_BR_EDR_ONLY=y
CONFIG_BTDM_CTRL_MODE_BLE_ONLY=n
CONFIG_BTDM_CTRL_MODE_BTDM=n
CONFIG_BT_A2DP_ENABLE=y
CONFIG_BT_L2CAP_ENABLED=y
CONFIG_BT_SDP_COMMON_ENABLED=y
CONFIG_FREERTOS_HZ=1000
CONFIG_ESP_MAIN_TASK_AFFINITY_CPU1=y
CONFIG_ESP_MAIN_TASK_STACK_SIZE=8192
CONFIG_LOG_DEFAULT_LEVEL_WARN=y
CONFIG_COMPILER_OPTIMIZATION_PERF=y
```

## sdkconfig.defaults
```kconfig
CONFIG_IDF_TARGET="esp32p4"
CONFIG_IDF_EXPERIMENTAL_FEATURES=y
CONFIG_ESP32P4_SELECTS_REV_LESS_V3=y
CONFIG_ESPTOOLPY_FLASHSIZE_16MB=y
CONFIG_PARTITION_TABLE_CUSTOM=y
CONFIG_PARTITION_TABLE_CUSTOM_FILENAME="partitions.csv"
CONFIG_COMPILER_OPTIMIZATION_PERF=y
CONFIG_ESP_DEFAULT_CPU_FREQ_MHZ_360=y
CONFIG_SPIRAM=y
CONFIG_SPIRAM_SPEED_200M=y
CONFIG_SPIRAM_USE_MALLOC=y
CONFIG_SPIRAM_MALLOC_ALWAYSINTERNAL=16384
CONFIG_SPIRAM_MALLOC_RESERVE_INTERNAL=65536
CONFIG_FREERTOS_HZ=1000
CONFIG_ESP_MAIN_TASK_STACK_SIZE=8192
CONFIG_ESP_CONSOLE_USB_SERIAL_JTAG=y
CONFIG_BSP_ERROR_CHECK=n
CONFIG_BSP_SD_FORMAT_ON_MOUNT_FAIL=n
CONFIG_BSP_SD_MOUNT_POINT="/sdcard"
CONFIG_BSP_LCD_USE_DMA2D=y
CONFIG_BSP_LCD_DPI_BUFFER_NUMS=3
CONFIG_BSP_DISPLAY_LVGL_AVOID_TEAR=n
CONFIG_LVGL_PORT_ENABLE_PPA=y
# CONFIG_LV_USE_TJPGD is not set
CONFIG_CODEC_I2C_BACKWARD_COMPATIBLE=n
CONFIG_CAM_CTRL_SPI_ENABLE=n
CONFIG_FATFS_LFN_HEAP=y
CONFIG_FATFS_MAX_LFN=255
CONFIG_FATFS_API_ENCODING_UTF_8=y
CONFIG_FATFS_USE_LABEL=y
CONFIG_FATFS_FS_LOCK=16
CONFIG_FATFS_PER_FILE_CACHE=y
CONFIG_FATFS_USE_FASTSEEK=n
CONFIG_FATFS_VFS_FSTAT_BLKSIZE=4096
CONFIG_FATFS_ALLOC_PREFER_EXTRAM=y
CONFIG_FATFS_IMMEDIATE_FSYNC=n
CONFIG_LV_CONF_SKIP=y
CONFIG_LV_COLOR_DEPTH_16=y
CONFIG_LV_USE_CLIB_MALLOC=y
CONFIG_LV_USE_CLIB_SPRINTF=y
CONFIG_LV_USE_CLIB_STRING=y
CONFIG_LV_BUILD_EXAMPLES=n
CONFIG_LV_USE_DEMO_WIDGETS=n
CONFIG_LV_USE_LODEPNG=y
CONFIG_LV_FONT_MONTSERRAT_14=y
CONFIG_LV_FONT_MONTSERRAT_16=y
CONFIG_LV_FONT_MONTSERRAT_18=y
CONFIG_LV_FONT_MONTSERRAT_20=y
CONFIG_LV_FONT_MONTSERRAT_24=y
CONFIG_LV_FONT_MONTSERRAT_28=y
CONFIG_LV_FONT_MONTSERRAT_32=y
CONFIG_LV_FONT_DEFAULT_MONTSERRAT_16=y
CONFIG_LV_DEF_REFR_PERIOD=16

# External codec component: only native FLAC and AAC ADTS are used.
CONFIG_AUDIO_DECODER_AAC_SUPPORT=y
CONFIG_AUDIO_DECODER_MP3_SUPPORT=n
CONFIG_AUDIO_DECODER_G711_SUPPORT=n
CONFIG_AUDIO_DECODER_AMRNB_SUPPORT=n
CONFIG_AUDIO_DECODER_AMRWB_SUPPORT=n
CONFIG_AUDIO_DECODER_FLAC_SUPPORT=y
CONFIG_AUDIO_DECODER_OPUS_SUPPORT=n
CONFIG_AUDIO_DECODER_VORBIS_SUPPORT=n
CONFIG_AUDIO_DECODER_ADPCM_SUPPORT=n
CONFIG_AUDIO_DECODER_ALAC_SUPPORT=n
CONFIG_AUDIO_DECODER_PCM_SUPPORT=n
CONFIG_AUDIO_DECODER_SBC_SUPPORT=n
CONFIG_AUDIO_DECODER_LC3_SUPPORT=n
CONFIG_AUDIO_DECODER_G722_SUPPORT=n
CONFIG_AUDIO_SIMPLE_DEC_WAV_SUPPORT=n
CONFIG_AUDIO_SIMPLE_DEC_M4A_SUPPORT=n
CONFIG_AUDIO_SIMPLE_DEC_TS_SUPPORT=n
CONFIG_AUDIO_SIMPLE_DEC_OGG_SUPPORT=n
CONFIG_AUDIO_ENCODER_AAC_SUPPORT=n
CONFIG_AUDIO_ENCODER_G711_SUPPORT=n
CONFIG_AUDIO_ENCODER_AMRNB_SUPPORT=n
CONFIG_AUDIO_ENCODER_AMRWB_SUPPORT=n
CONFIG_AUDIO_ENCODER_OPUS_SUPPORT=n
CONFIG_AUDIO_ENCODER_ADPCM_SUPPORT=n
CONFIG_AUDIO_ENCODER_ALAC_SUPPORT=n
CONFIG_AUDIO_ENCODER_PCM_SUPPORT=n
CONFIG_AUDIO_ENCODER_SBC_SUPPORT=n
CONFIG_AUDIO_ENCODER_LC3_SUPPORT=n
CONFIG_AUDIO_ENCODER_G722_SUPPORT=n

CONFIG_LV_USE_SNAPSHOT=y
# RGB565 rows are not always aligned to four bytes; avoid the slow ROM memcpy path.
CONFIG_LIBC_OPTIMIZED_MISALIGNED_ACCESS=y
```
